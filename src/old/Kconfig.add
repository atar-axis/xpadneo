## src/old/Kconfig.add
```kconfig
menu "HID support"
     depends on INPUT

if HID

menu "Special HID drivers"
	depends on HID

config HID_XPADNEO
    tristate "XBOX ONE S and X controller over Bluetooth with FF (custom)"
    depends on HID
    ---help---
    This is a custom driver. It aims to support the XBOX ONE S and X controller with FF over BT.

endmenu

endif # HID

endmenu
```
